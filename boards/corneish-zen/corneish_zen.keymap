/*
*
* Copyright (c) 2021 Darryl deHaan
* SPDX-License-Identifier: MIT
*
*/

#include <behaviors.dtsi>
#include <dt-bindings/zmk/keys.h>
#include <dt-bindings/zmk/bt.h>
#include <dt-bindings/zmk/ext_power.h>
#include <dt-bindings/zmk/outputs.h>

/ {
  chosen {
    zmk,matrix_transform = &five_column_transform;
  };
};

#include "layers.h"
#include "home_row_mods.dtsi"
#include "combos.dtsi"
#include "miryoku_36.keymap"
