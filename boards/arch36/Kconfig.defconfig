## boards/arch36/Kconfig.defconfig
```kconfig
if SHIELD_ARCH36_LEFT

config ZMK_KEYBOARD_NAME
	default "Arch 36"

config ZMK_SPLIT_BLE_ROLE_CENTRAL
  default y

endif


if SHIELD_ARCH36_RIGHT

config ZMK_KEYBOARD_NAME
	default "Arch 36 Right"

endif

if SHIELD_ARCH36_LEFT || SHIELD_ARCH36_RIGHT

config ZMK_SPLIT
	default y
 
endif
```

## boards/arch36/Kconfig.shield
```kconfig
# Copyright (c) 2020 Pete Johanson
# SPDX-License-Identifier: MIT

config SHIELD_ARCH36_LEFT
	def_bool $(shields_list_contains,arch36_left)

config SHIELD_ARCH36_RIGHT
	def_bool $(shields_list_contains,arch36_right)
```

## boards/corneish-zen/west.yml
```yaml
---
manifest:
  remotes:
    - name: bravekarma
      url-base: https://github.com/caksoylar
  projects:
    - name: zmk
      remote: bravekarma
      # https://gist.github.com/caksoylar/c411313990978e1903c244f03039187a
      revision: caksoylar/zen-v1+v2
      import: app/west.yml
  self:
    path: config
```

## boards/ergotravel/Kconfig.defconfig
```kconfig
if SHIELD_ERGOTRAVEL_LEFT

config ZMK_KEYBOARD_NAME
    default "ErgoTravel"

config ZMK_SPLIT_BLE_ROLE_CENTRAL
    default y

endif

if SHIELD_ERGOTRAVEL_RIGHT

config ZMK_KEYBOARD_NAME
    default "ErgoTravel Right"

endif

if SHIELD_ERGOTRAVEL_LEFT || SHIELD_ERGOTRAVEL_RIGHT

config ZMK_SPLIT
    default y

endif
```

## boards/ergotravel/Kconfig.shield
```kconfig
config SHIELD_ERGOTRAVEL_LEFT
        def_bool $(shields_list_contains,ergotravel_left)

config SHIELD_ERGOTRAVEL_RIGHT
        def_bool $(shields_list_contains,ergotravel_right)
```

## boards/waterfowl/Kconfig.defconfig
```kconfig
if SHIELD_WATERFOWL_LEFT

config ZMK_KEYBOARD_NAME
	default "Waterfowl"

config ZMK_SPLIT_BLE_ROLE_CENTRAL
  default y

endif

if SHIELD_WATERFOWL_RIGHT

config ZMK_KEYBOARD_NAME
	default "Waterfowl Right"

endif

if SHIELD_WATERFOWL_LEFT || SHIELD_WATERFOWL_RIGHT

config ZMK_SPLIT
	default y

endif
```

## boards/waterfowl/west.yml
```yaml
---
manifest:
  remotes:
    - name: bravekarma
      url-base: https://github.com/caksoylar
  projects:
    - name: zmk
      remote: bravekarma
      revision: caksoylar/experimental  # https://github.com/zmkfirmware/zmk/pull/2027#issuecomment-2231678922
      import: app/west.yml
  self:
    path: config
```

## west.yml
```yaml
manifest:
  remotes:
    - name: zmkfirmware
      url-base: https://github.com/zmkfirmware
    - name: petejohanson
      url-base: https://github.com/petejohanson
  projects:
    - name: zmk
      remote: zmkfirmware
      revision: main
      # remote: petejohanson
      # revision: ble/hog-characteristic-perm-tweaks-macos
      import: app/west.yml
  self:
    path: config
```
