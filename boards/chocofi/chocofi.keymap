#include <behaviors.dtsi>
#include <dt-bindings/zmk/keys.h>
#include <dt-bindings/zmk/bt.h>
#include <dt-bindings/zmk/ext_power.h>
#include <dt-bindings/zmk/outputs.h>

#include "../../../layers.h"
#include "../../../home_row_mods.dtsi"
#include "../../../combos.dtsi"
#include "../../../miryoku_36_flipped.keymap"
