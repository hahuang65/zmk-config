#include <behaviors.dtsi>

/ {
	behaviors {
		hm: homerow_mods {
			compatible = "zmk,behavior-hold-tap";
			label = "HOMEROW_MODS";
			#binding-cells = <2>;
			tapping-term-ms = <150>;
			flavor = "tap-preferred";
			bindings = <&kp>, <&kp>;
		};
  };
};
