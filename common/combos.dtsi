/*                KEY POSITIONS

  ╭────────────────────╮ ╭────────────────────╮
  │  0   1   2   3   4 │ │  5   6   7   8   9 │
  │ 20  11  12  13  14 │ │ 15  16  17  18  19 │
  │ 20  21  22  23  24 │ │ 25  26  27  28  29 │
  ╰───────╮ 30  31  32 │ │ 33  34  35 ╭───────╯
          ╰────────────╯ ╰────────────╯         */

#define COMBO(NAME, BINDINGS, KEYPOS, LAYERS, TERM) \
        combo_##NAME { \
            timeout-ms = <TERM>; \
            bindings = <BINDINGS>; \
            key-positions = <KEYPOS>; \
            layers = <LAYERS>; \
        };

&caps_word {
  continue-list = <UNDERSCORE MINUS BSPC DEL N1 N2 N3 N4 N5 N6 N7 N8 N9 N0>;
};

/ {
  combos {
    compatible = "zmk,combos";

COMBO(lpar,   &kp LPAR,     2 3, DEFAULT MAC, 20)
COMBO(rpar,   &kp RPAR,     6 7, DEFAULT MAC, 20)
COMBO(lbkt,   &kp LBKT,     1 2, DEFAULT MAC, 20)
COMBO(rbkt,   &kp RBKT,     7 8, DEFAULT MAC, 20)
COMBO(lbrc,   &kp LBRC,     1 3, DEFAULT MAC, 20)
COMBO(rbrc,   &kp RBRC,     6 8, DEFAULT MAC, 20)
COMBO(capswd, &caps_word,   13 16, DEFAULT MAC, 60)
COMBO(gamemd, &tog GAME,    20 29, DEFAULT GAME, 60)
  };
};
